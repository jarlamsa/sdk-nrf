## subsys/net/lib/lwm2m_client_utils/Kconfig
```kconfig
#
# Copyright (c) 2021 Nordic Semiconductor
#
# SPDX-License-Identifier: LicenseRef-Nordic-5-Clause
#

menuconfig LWM2M_CLIENT_UTILS
	bool "LWM2M client utilities library"
	select LWM2M

if LWM2M_CLIENT_UTILS

config LWM2M_CLIENT_UTILS_DEVICE_OBJ_SUPPORT
	bool "Device object support"
	default y

config LWM2M_CLIENT_UTILS_SECURITY_OBJ_SUPPORT
	bool "Security object support"
	default y

config LWM2M_CLIENT_UTILS_CONN_MON_OBJ_SUPPORT
	bool "Connection Monitor object support"
	default y
	select LWM2M_CONN_MON_OBJ_SUPPORT

if LWM2M_CLIENT_UTILS_CONN_MON_OBJ_SUPPORT

config LWM2M_CONN_MON_BEARER_MAX
	int "Max number of bearers"
	default 2

endif # LWM2M_CLIENT_UTILS_CONN_MON_OBJ_SUPPORT

config LWM2M_CLIENT_UTILS_LOCATION_OBJ_SUPPORT
	bool "Location object support"
	default y
	select LWM2M_LOCATION_OBJ_SUPPORT

choice
	prompt "Firmware update mechanism"
	optional

config LWM2M_CLIENT_UTILS_FIRMWARE_UPDATE_OBJ_SUPPORT
	bool "Firmware Update object support"
	select LWM2M_FIRMWARE_UPDATE_OBJ_SUPPORT
	select DFU_TARGET
	select BOOTLOADER_MCUBOOT
	select IMG_MANAGER
	select IMG_ERASE_PROGRESSIVELY
	select FLASH
	select MPU_ALLOW_FLASH_WRITE

config LWM2M_CLIENT_UTILS_SOFTWARE_MGMT_OBJ_SUPPORT
	bool "Software Management object support"
	select LWM2M_SOFTWARE_MGMT_OBJ_SUPPORT
	select DFU_TARGET
	select BOOTLOADER_MCUBOOT
	select IMG_MANAGER
	select IMG_ERASE_PROGRESSIVELY
	select FLASH
	select MPU_ALLOW_FLASH_WRITE

endchoice

if LWM2M_CLIENT_UTILS_SOFTWARE_MGMT_OBJ_SUPPORT

config LWM2M_CLIENT_UTILS_SOFTWARE_MGMT_INSTANCE_MODEM
	int "Software management object instance for modem firmware"
	range 0 2
	default 0

config LWM2M_CLIENT_UTILS_SOFTWARE_MGMT_INSTANCE_APP
	int "Software management object instance for application"
	range 0 2
	default 1

endif

config LWM2M_CLIENT_UTILS_DOWNLOADER_SEC_TAG
	int "Security tag for FOTA download library"
	depends on LWM2M_CLIENT_UTILS_FIRMWARE_UPDATE_OBJ_SUPPORT || LWM2M_CLIENT_UTILS_SOFTWARE_MGMT_OBJ_SUPPORT
	default 16842753
	help
	  This security tag is used when firmware image is fetch from
	  https:// or coaps:// URI. It has no effect on usage of http:// or coap://
	  -1 disables the usage of security tag.


module = LWM2M_CLIENT_UTILS
module-dep = LOG
module-str = LwM2M client utilities library
source "${ZEPHYR_BASE}/subsys/logging/Kconfig.template.log_config"

endif # LWM2M_CLIENT_UTILS
```
